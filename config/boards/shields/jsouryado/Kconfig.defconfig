## config/boards/shields/jsouryado/Kconfig.defconfig
```kconfig
# Copyright (c) 2021 The ZMK Contributors
# SPDX-License-Identifier: MIT

if JSOURYADO_LEFT

config ZMK_KEYBOARD_NAME
    default "jsouryado"

endif

if JSOURYADO_LEFT || JSOURYADO_RIGHT

config ZMK_SPLIT
    default y

endif
```
